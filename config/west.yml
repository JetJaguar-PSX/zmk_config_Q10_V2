## config/west.yml
```yaml
manifest:
  remotes:
    - name: zmkfirmware
      url-base: https://github.com/zmkfirmware
    - name: ZitaoTech
      url-base: https://github.com/ZitaoTech
    - name: JetJaguar-PSX
      url-base: https://github.com/JetJaguar-PSX
  projects:
    - name: zmk
      remote: JetJaguar-PSX
      revision: dev/shiitake/bbq10
      import: app/west.yml
  self:
    path: config
```
